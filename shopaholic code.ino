#define AtomizerPIN 3 //define the relay control pin number as pin 3
#define idrPin A0

#include <Servo.h>                                                                                                                                                                                                                        
    Servo myservo;
    int pos = 0; // Angle storage variable
    int ledPin=13;
    int val=0;
    int a;
    int data;
    const int buzzerPin = 6; // intervention port of the buzzer
    int MoPin = 5; // vibrator connected to digital pin 5
    //boolean ledState=false;

void setup()
{    
  Serial.begin(9600);    
  myservo.attach(9); // control line connected to digital pin 9
  pinMode(AtomizerPIN,OUTPUT);
  pinMode(buzzerPin,OUTPUT);
  pinMode(13,OUTPUT);
  digitalWrite(buzzerPin,LOW);
  pinMode( MoPin, OUTPUT );
}

void buzzer_di(){
  digitalWrite(buzzerPin,HIGH);
  delay(1000);
  digitalWrite(buzzerPin,LOW);
  delay(1000);
  }
void buzzer_didi(){
  digitalWrite(buzzerPin,HIGH);
  delay(100);
  digitalWrite(buzzerPin,LOW);
  delay(100);
  }

void loop()
{   
  int guangmin=analogRead(idrPin); //read in the analog signal generated by the photoresistor (range: 0~1023)
    Serial.print("value= ");
    Serial.print(guangmin);
  int guangmin2=map(guangmin,0,1023,255,0); //map function Maps 0~1023 range to 255~0
    //write 255,0 backwards here; because you want to achieve a brighter LED as the light intensity increases
    Serial.print("--");
    Serial.println(guangmin2);  
       delay(100); //delay 100ms 
    if(Serial.available())
    {
    data = Serial.read();
if(data == 'A'){
 digitalWrite(ledPin,HIGH);
           delay(1000);
 digitalWrite(ledPin,LOW);
    }
  }
    // int val = 2;
  // val=digitalRead(ledPin);
  if(guangmin2<30)
    {
      a++;
       if(a==3||a==6||a==9||a==12){
       // ledState=!ledState;
        buzzer_di();
       }
       if(a==13|||a==14||a==15){
         buzzer_didi();buzzer_didi();buzzer_didi();
       }
       if(a==18||a==21||a==24){
        digitalWrite(MoPin, HIGH);         
        delay(1000);                           
        digitalWrite(MoPin, LOW);         
        delay(1000); 
       }
       if(a==15){
         for (pos = 0; pos <= 180; pos ++) { // 0° to 180°
    // in steps of 1 degree
           myservo.write(pos); // write the servo angle
           delay(5); // wait for rotation to the specified angle
         }
 
         for (pos = 180; pos >= 0; pos --) { // from 180° to 0°
           myservo.write(pos); // write the servo angle
           delay(5); // wait for rotation to the specified angle
         }// Servo and smoker code
        }
      }
    digitalWrite(AtomizerPIN, LOW);// output LOW level, relay module open, thus fogger work 
// digitalWrite(AtomizerPIN, HIGH);// output HIGH level, relay module off, thus fogger off 
}